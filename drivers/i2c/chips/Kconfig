## drivers/i2c/chips/Kconfig
```kconfig
#
# Miscellaneous I2C chip drivers configuration
#
# *** DEPRECATED! Do not add new entries! See Makefile ***
#

menu "Miscellaneous I2C Chip support"

config SENSORS_MT9T013
	tristate "MT9T013 Camera Driver"
	depends on I2C
	default y
	help
	 MT9T013 Camera Driver implemented by HTC.

config SENSORS_YDA165
	bool "YDA165 Audio Amp Driver"
	depends on I2C
	default n
	help
	 YDA165 Audio AMP	

config SENSORS_MAX9877
	tristate "MAX9877 Audio Amp Driver"
	depends on I2C
	default n
	help
	 MAXIM 9877 Audio AMP	 

config SENSORS_MAX9879
	tristate "MAX9879 Audio Amp Driver"
	depends on I2C
	default n
	help
	 MAXIM 9879 Audio AMP	 

config SENSORS_FSA9480
	tristate "FSA9480 Micro USB Switch IC Driver"
	depends on I2C
	default n
	help
	 FSA9480 Micro USB Switch IC Driver

config VP_A1026
	tristate "A1026 Voice Processor Driver"
	depends on I2C
	help
	  A1026 Voice Processor Driver implemented by HTC.

config SENSORS_KR3D_ACCEL
	tristate "STMicroelectronics KR3DH Acceleration Sensor"
	depends on I2C

config INPUT_KR3DH_POSITION
	int "KR3DH Mounting Position on Board"
	depends on SENSORS_KR3D_ACCEL
	default "0"
	help
	  Chip mounting position (pin 1).
	    0: top, upper-left
	    1: top, upper-right
	    2: top, lower-right
	    3: top, lower-left
	    4: bottom, upper-left
	    5: bottom, upper-right
	    6: bottom, lower-right
	    7: bottom, lower-left

config INPUT_YAS_MAGNETOMETER
         tristate "YAS Geomagnetic Sensor"
         depends on I2C

config INPUT_YAS_MAGNETOMETER_POSITION
         int "YAS Geomagnetic Sensor Mounting Position on Board"
         depends on INPUT_YAS_MAGNETOMETER
         default "0"
         help
           Chip mounting position (pin 1).
              0: top, upper-left
              1: top, upper-right
              2: top, lower-right
              3: top, lower-left
              4: bottom, upper-left
              5: bottom, upper-right
              6: bottom, lower-right
              7: bottom, lower-left

config SENSORS_YAS529_MAGNETIC
	tristate "Yamaha YAS529 Geomagnetic Sensor"
	depends on I2C

config INPUT_YAS529_POSITION
	int "YAS529 Mounting Position on Board"
	depends on SENSORS_YAS529_MAGNETIC
	default "0"
	help
	  Chip mounting position (pin 1).
	    0: top, upper-left
	    1: top, upper-right
	    2: top, lower-right
	    3: top, lower-left
	    4: bottom, upper-left
	    5: bottom, upper-right
	    6: bottom, lower-right
	    7: bottom, lower-left
	    
config SENSORS_ORIENTATION
	tristate "Yamaha Orientation Sensor"
	depends on I2C

config OPTICAL_GP2A
	depends on I2C
	tristate "GP2A driver"
	default y
	help
	  This option enables proximity & light sensors using gp2a driver.

config GYRO_L3G4200D
	depends on I2C
	tristate "L3G4200D driver"
	default y
	help
	  This option enables gyro sensors using L3G4200D driver	  

config SENSORS_BMA222
	tristate "Bosch BMA222 acceleration sensor support"
	depends on I2C=y
	default n
	help
	  If you say yes here you get support for Bosch's 

endmenu
```

## drivers/net/wibro_cmc/Kconfig
```kconfig
#
# WIBRO_CMC LAN device drivers configuration
#



menuconfig WIBRO_CMC
		bool "samsung wibro cmc support"
		default n
```
